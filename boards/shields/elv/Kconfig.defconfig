## boards/shields/elv/Kconfig.defconfig
```kconfig
if SHIELD_ELV

config ZMK_KEYBOARD_NAME
    default "ELV"

config ZMK_DISPLAY
    default y

config I2C
    default n

config SPI
    default y

endif
```
